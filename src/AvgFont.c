/********************************************************************
* @file       : AvgFont.c
* @author     : Glushanenko Alexander
* @version    : V1.0.0
* @date       : 28.11.2025
* @brief      : Binary font array and font rendering functions.
********************************************************************/

#include "AvgFont.h"
#include "AvgOledSSD1306.h"

// ---------------------------------------------------------------------------------------------------------------------------------------------------------

#ifdef FONT_USE_12x16

const uint16_t font_12x16[0x80][FONT_X_SIZE] = {
    {0x0000, 0x0000, 0x0000, 0x0000, 0x0000, 0x0000, 0x0000, 0x0000, 0x0000, 0x0000, 0x0000, 0x0000}, // 0x00 ' '
    {0x0000, 0x0000, 0x0000, 0x0000, 0x0000, 0x0000, 0x0000, 0x0000, 0x0000, 0x0000, 0x0000, 0x0000}, // 0x01 ' '
    {0x0000, 0x0000, 0x0000, 0x0000, 0x0000, 0x0000, 0x0000, 0x0000, 0x0000, 0x0000, 0x0000, 0x0000}, // 0x02 ' '
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    {0x0000, 0x0000, 0x0000, 0x0000, 0x0000, 0x0000, 0x0000, 0x0000, 0x0000, 0x0000, 0x0000, 0x0000} // 0x7F ''
};

void AvgFontPrintChar(uint8_t *buf, uint32_t bufsize, uint8_t lcdwidth, uint8_t char_code, uint8_t y_pos_page, uint8_t x_pos_sym){
	uint32_t startpos = y_pos_page * lcdwidth + x_pos_sym * (FONT_SPACE_START + FONT_SPACE_END + FONT_X_SIZE); // start byte in [oledbuf] to print char
	for(uint32_t i = startpos; i < startpos + FONT_SPACE_START; i++)
		buf[i] = 0x00; // START SPACE
	uint8_t j = 0;
	uint8_t part1 = 0; // byte for high page
	uint8_t part2 = 0; // byte for low page
	for(uint32_t i = startpos + FONT_SPACE_START; i < startpos + FONT_SPACE_START + FONT_X_SIZE && i + lcdwidth < bufsize; i++){ // && i < bufsize
		part1 = (uint8_t)font_12x16[char_code][j];
		part2 = (uint8_t)(font_12x16[char_code][j] >> 8);
		buf[i] = part1;
		buf[i + lcdwidth] = part2;
		j++;
	}
	for(uint32_t i = startpos + FONT_SPACE_START + FONT_X_SIZE; i < startpos + FONT_SPACE_START + FONT_X_SIZE + FONT_SPACE_END; i++)
		buf[i] = 0x00; // END SPACE
}

#endif

// ---------------------------------------------------------------------------------------------------------------------------------------------------------

#ifdef FONT_USE_5x8

static uint8_t font_5x8[0x80][FONT_X_SIZE] = {
	{0x00, 0x00, 0x00, 0x00, 0x00}, // 0x00 (0)
	{0x00, 0x00, 0x00, 0x00, 0x00}, // 0x01 (1)
	{0x00, 0x00, 0x00, 0x00, 0x00}, // 0x02 (2)
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	{0x00, 0x00, 0x00, 0x00, 0x00} // 0x7F (127)
};

void AvgFontPrintChar(uint8_t *buf, uint32_t bufsize, uint8_t oledwidth, uint8_t char_code, uint8_t y_pos_page, uint8_t x_pos_sym){
	uint32_t startpos = y_pos_page * oledwidth + x_pos_sym * (FONT_SPACE_START + FONT_SPACE_END + FONT_X_SIZE); // start byte in [oledbuf] to print char
	for(uint32_t i = startpos; i < startpos + FONT_SPACE_START; i++)
		buf[i] = 0x00; // START SPACE
	uint8_t j = 0;
	for(uint32_t i = startpos + FONT_SPACE_START; i < startpos + FONT_SPACE_START + FONT_X_SIZE && i < bufsize; i++){
		buf[i] = font_5x8[char_code][j];
		j++;
	}
	for(uint32_t i = startpos + FONT_SPACE_START + FONT_X_SIZE; i < startpos + FONT_SPACE_START + FONT_X_SIZE + FONT_SPACE_END; i++)
		buf[i] = 0x00; // END SPACE
}

#endif

// ---------------------------------------------------------------------------------------------------------------------------------------------------------
